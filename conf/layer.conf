## conf/layer.conf
```bitbake
# We have a conf and classes directory, add to BBPATH
BBPATH .= ":${LAYERDIR}"

# We have recipes-* directories, add to BBFILES
BBFILES += "${LAYERDIR}/recipes-*/*/*.bb \
            ${LAYERDIR}/recipes-*/*/*.bbappend"

BBFILE_COLLECTIONS += "meta-int"
BBFILE_PATTERN_meta-int = "^${LAYERDIR}/"
BBFILE_PRIORITY_meta-int = "6"

LAYERDEPENDS_meta-int = "core"
LAYERSERIES_COMPAT_meta-int = "kirkstone"
```
